## Documentation/devicetree/bindings/sound/everest,es7210.yaml
```yaml
# SPDX-License-Identifier: (GPL-2.0-only OR BSD-2-Clause)
%YAML 1.2
---
$id: http://devicetree.org/schemas/sound/everest,es7210.yaml#
$schema: http://devicetree.org/meta-schemas/core.yaml#

title: Everest Semiconductor ES7210 4-channel audio ADC

maintainers:
  - wanfanggreat <13409332807@163.com>

description: |
  The ES7210 is a four-channel audio ADC with an I2C control interface and
  an I2S/TDM output.  It is used as a microphone front end; its serial
  output feeds the SoC's I2S capture direction.

properties:
  compatible:
    enum:
      - everest,es7210

  reg:
    maxItems: 1

  '#sound-dai-cells':
    const: 0

  clocks:
    maxItems: 1
    description: Optional master clock (MCLK) supplied to the ADC.

  clock-names:
    const: mclk

  vd-supply:
    description: Digital (VD) supply regulator.

  vp-supply:
    description: Analogue (VP) supply regulator.

required:
  - compatible
  - reg
  - '#sound-dai-cells'

additionalProperties: false

examples:
  - |
    i2c {
        #address-cells = <1>;
        #size-cells = <0>;

        audio-adc@40 {
            compatible = "everest,es7210";
            reg = <0x40>;
            #sound-dai-cells = <0>;
        };
    };
```
